## boards/shields/corne/Kconfig.shield
```kconfig
config SHIELD_CORNE_LEFT
    def_bool $(shields_list_contains,corne_left)

config SHIELD_CORNE_RIGHT
    def_bool $(shields_list_contains,corne_right)

config SHIELD_CORNE
    def_bool SHIELD_CORNE_LEFT || SHIELD_CORNE_RIGHT
    select ZMK_SPLIT
    select ZMK_SPLIT_ROLE_CENTRAL if SHIELD_CORNE_LEFT

if SHIELD_CORNE

config ZMK_KEYBOARD_NAME
    default "Drako"

config ZMK_SPLIT_BLE_ROLE_CENTRAL
    default y if SHIELD_CORNE_LEFT

endif
```
